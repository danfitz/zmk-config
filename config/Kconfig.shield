## config/Kconfig.shield
```kconfig
# Copyright (c) 2021 The ZMK Contributors
# SPDX-License-Identifier: MIT

config SHIELD_4X12
    def_bool $(shields_list_contains,4x12)
```

## config/boards/shields/4x12/Kconfig.defconfig
```kconfig
# Copyright (c) 2021 The ZMK Contributors
# SPDX-License-Identifier: MIT

if SHIELD_4X12

config ZMK_KEYBOARD_NAME
    default "4x12"

endif
```
